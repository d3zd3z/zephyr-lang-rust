## samples/philosophers/sample.yaml
```yaml
sample:
  description: Philosphers, in Rust
  name: philosophers rust
common:
  harness: console
  harness_config:
    type: one_line
    regex:
      - "Child 5 thinking"
  tags: rust
  filter: CONFIG_RUST_SUPPORTED
tests:
  sample.rust.philosopher.sysmutex:
    tags: introduction
    min_ram: 32
```

## tests/time/testcase.yaml
```yaml
common:
  filter: CONFIG_RUST_SUPPORTED
  tags: rust
tests:
  test.rust.time:
    harness: console
    harness_config:
      type: one_line
      regex:
        - "All tests passed"
```
